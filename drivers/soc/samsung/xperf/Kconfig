## drivers/soc/samsung/xperf/Kconfig
```kconfig
#
# Exynos CPU Performance Profiling
#
config EXYNOS_PERF
	tristate "Exynos Performance Drivers"
	default y
	help
	  Enable Exynos Performance Drivers
	  
config ARM_FREQ_QOS_TRACER
        tristate "trace exprimental"
        default n
        help
          this config is exprimental
```
